## sdkconfig.defaults
```kconfig
# Override some defaults so BT stack is enabled
# in this example

#
# STATION Vars Configuration
#

#
# WIFI Configuration
#
CONFIG_ESP_WIFI_SSID="VideoPP"
CONFIG_ESP_WIFI_PASSWORD="ZelenaParadajka24"
CONFIG_ESP_MAXIMUM_RETRY=5
CONFIG_ESP_WIFI_AUTH_WPA2_PSK=y
# end of WIFI Configuration

#
# MQTT Configuration
#
CONFIG_ESP_MQTT_HOST_URI="mqtt://gavo-m1-pro.local:1883"
# end of MQTT Configuration

#
# LED Configuration
#
CONFIG_ESP_LED_PIN=47
CONFIG_ESP_LED_PIN_LEN=1
# end of LED Configuration
# end of STATION Vars Configuration


# BT config
CONFIG_BT_ENABLED=y
CONFIG_PARTITION_TABLE_SINGLE_APP_LARGE=y

# enable NIMBLE api
CONFIG_BT_NIMBLE_ENABLED=y
CONFIG_BT_BLUEDROID_ENABLED=n
CONFIG_BT_NIMBLE_NVS_PERSIST=y
CONFIG_BT_NIMBLE_SECURITY_ENABLE=y
CONFIG_BT_NIMBLE_SM_SC=y

# enable cenral role aka im connecting to device
CONFIG_BT_NIMBLE_ROLE_CENTRAL=y

# disable other roles
CONFIG_BT_NIMBLE_ROLE_BROADCASTER=n
CONFIG_BT_NIMBLE_MESH=n
CONFIG_BT_NIMBLE_ROLE_OBSERVER=n
CONFIG_BT_NIMBLE_ROLE_PERIPHERAL=n

# CONFIG_BT_LE_50_FEATURE_SUPPORT is not used on ESP32, ESP32-C3 and ESP32-S3.
CONFIG_BT_BLE_50_FEATURES_SUPPORTED=n
CONFIG_BT_BLE_42_FEATURES_SUPPORTED=y
CONFIG_BT_NIMBLE_50_FEATURE_SUPPORT=n

# WiFi config
CONFIG_ESP_WIFI_IRAM_OPT=n
CONFIG_ESP_WIFI_SOFTAP_SUPPORT=n

# Coex config
CONFIG_ESP_COEX_SW_COEXIST_ENABLE=y
CONFIG_BT_BLE_DYNAMIC_ENV_MEMORY=y

# Default 4, because i need 4 subsciptions and 2 writes at the same time just max out the MAX
CONFIG_BT_NIMBLE_GATT_MAX_PROCS=20
```
